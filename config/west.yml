## config/west.yml
```yaml
manifest:
  defaults:
    remote: urob
    revision: v0.1

  remotes:
    - name: upstream
      url-base: https://github.com/zmkfirmware
    - name: urob
      url-base: https://github.com/urob
    - name: infely
      url-base: https://github.com/infely

  projects:
    - name: zmk-auto-layer
      path: modules/auto-layer
    - name: zmk-helpers
      path: modules/helpers
    - name: zmk-leader-key
      path: modules/leader-key
    - name: zmk-tri-state
      path: modules/tri-state
    - name: nice-view-battery
      remote: infely
      revision: main
      path: modules/nice-view-battery
    - name: zephyr
      remote: upstream
      revision: v3.5.0+zmk-fixes
      clone-depth: 1
      import:
        name-allowlist:
          - cmsis
          - hal_nordic
          - hal_rpi_pico
          - hal_stm32
          - lvgl
          - tinycrypt
    - name: zmk
      path: .
      import:
        file: app/west.yml
        path-prefix: zmk

  self:
    path: config
```
